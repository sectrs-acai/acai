## buildconf/buildroot_packages/Config.in
```kconfig
source "$BR2_EXTERNAL_ARMCCA_PATH/package/scanmem/Config.in"
source "$BR2_EXTERNAL_ARMCCA_PATH/package/pteditor/Config.in"
source "$BR2_EXTERNAL_ARMCCA_PATH/package/guest_user/Config.in"
source "$BR2_EXTERNAL_ARMCCA_PATH/package/guest_kernel_module/Config.in"
source "$BR2_EXTERNAL_ARMCCA_PATH/package/fvp_escape_host/Config.in"
source "$BR2_EXTERNAL_ARMCCA_PATH/package/gdev_host/Config.in"
source "$BR2_EXTERNAL_ARMCCA_PATH/package/gdev_guest/Config.in"
source "$BR2_EXTERNAL_ARMCCA_PATH/package/gdev_guest_cuda/Config.in"
source "$BR2_EXTERNAL_ARMCCA_PATH/package/gdev_guest_cuda_rt/Config.in"
source "$BR2_EXTERNAL_ARMCCA_PATH/package/python-cryptography_port/Config.in"
```

## buildconf/buildroot_packages/package/fvp_escape_host/Config.in
```kconfig
config BR2_PACKAGE_FVP_ESCAPE_HOST
	bool "fvp_escape_host"
	select BR2_LINUX_KERNEL
    select BR2_PACKAGE_PTEDITOR
    select BR2_PACKAGE_SCANMEM
    default "n"
	help
		escape_host
```

## buildconf/buildroot_packages/package/gdev_guest_cuda/Config.in
```kconfig
config BR2_PACKAGE_GDEV_GUEST_CUDA
	bool "gdev_guest_cuda"
	help
      Gdev Guest cuda build
```

## buildconf/buildroot_packages/package/gdev_guest_cuda_rt/Config.in
```kconfig
config BR2_PACKAGE_GDEV_GUEST_CUDA_RT
	bool "gdev_guest_cuda_rt"
	help
      Gdev Guest cuda runtime api build
```

## buildconf/buildroot_packages/package/guest_kernel_module/Config.in
```kconfig
config BR2_PACKAGE_GUEST_KERNEL_MODULE
	bool "guest_kernel_module"
	default "n"
	depends on BR2_LINUX_KERNEL
	help
	  guest kernel module
```

## buildconf/buildroot_packages/package/pteditor/Config.in
```kconfig
config BR2_PACKAGE_PTEDITOR
	bool "pteditor"
	default "n"
	depends on BR2_LINUX_KERNEL
	help
	  pteditor
```

## buildconf/buildroot_packages/package/python-cryptography_port/Config.in
```kconfig
config BR2_PACKAGE_PYTHON_CRYPTOGRAPHY_PORT
	bool "python-cryptography-port"
	depends on BR2_PACKAGE_HOST_RUSTC_TARGET_ARCH_SUPPORTS
	select BR2_PACKAGE_OPENSSL
	select BR2_PACKAGE_PYTHON_CFFI # runtime
	help
	  cryptography is a package designed to expose cryptographic
	  primitives and recipes to Python developers.

	  https://cryptography.io
```

## buildconf/buildroot_packages/package/scanmem/Config.in
```kconfig
config BR2_PACKAGE_SCANMEM
	bool "scanmem"
	depends on BR2_LINUX_KERNEL
    default "n"
	help
		scan mem
```
